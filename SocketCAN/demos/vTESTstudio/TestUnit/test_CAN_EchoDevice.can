/*@!Encoding:65001*/
includes
{
  
}

variables
{
  long  result_ID;
  long  result_Message;
  
  dword timeout = 1000; 

  message CAN1.CAN_MSG expected_CAN_frame;  
  message CAN1.CAN_ECHO_MSG expected_CAN_echo_frame;

  message CAN1.CAN_FD_MSG expected_CAN_FD_frame;  
  message CAN1.CAN_FD_ECHO_MSG expected_CAN_FD_echo_frame;

  float expected_CAN_signal = 0xBBBBAAAA;
  float expected_CAN_echo_signal = 0x00BBBBAA;
  float expected_CAN_FD_signal = 0xDDCCBBAA; //DDCCBBAADDCCBBAADDCCBBAADDCCBBAADDCCBBAADDCCBBAADDCCBBAADDCCBBAADDCCBBAADDCCBBAADDCCBBAADDCCBBAA;
  float expected_CAN_FD_echo_signal = 0x00DDCCBB; // BBCCDDAABBCCDDAABBCCDDAABBCCDDAABBCCDDAABBCCDDAABBCCDDAABBCCDDAABBCCDDAABBCCDDAABBCCDDAABBCCDDAABBCCDDAABBCCDDAABBCCDDAABBCCDD00;
}

void CheckTestResult(char testName[], int result)
{
  if(result == -2)
  {
    TestStepFail(testName, "FAILED: Resume due to constraint violation");
  }
  else if (result == -1)
  {
    TestStepFail(testName, "FAILED: General error");
  }
  else if(result == 0)
  {
    TestStepFail(testName, "FAILED: No message within timeout");
  }
  else if(result == 1)
  {
    TestStepPass(testName, "SUCCESS");
  }
  else
  {
    TestStepFail(testName, "FAILED: Undefined error");
  }
}

export testcase testWaitForCAN_msg_ID()
{  
    result_ID = TestWaitForMessage(expected_CAN_frame.id, timeout);
    CheckTestResult("testWaitForCAN_msg_ID", result_ID);
}

export testcase testWaitForEcho_msg_ID()
{ 
    result_ID = testWaitForMessage(expected_CAN_echo_frame.id, timeout);
    CheckTestResult("testWaitForEcho_msg_ID", result_ID);
}

export testcase testWaitForCAN_msg_Content()
{  
    result_Message = testWaitForSignalMatch(CAN_MSG::CAN_SIGNAL, expected_CAN_signal, timeout);
    CheckTestResult("testWaitForCAN_msg_Content", result_Message);
}

export testcase testWaitForEcho_msg_Content()
{ 
    result_Message = testWaitForSignalMatch(CAN_ECHO_MSG::CAN_SIGNAL, expected_CAN_echo_signal,timeout);
    CheckTestResult("testWaitForEcho_msg_Content", result_Message);
}

//
export testcase testWaitForCAN_FD_msg_ID()
{  
    result_ID = TestWaitForMessage(expected_CAN_FD_frame.id, timeout);
    CheckTestResult("testWaitForCAN_FD_msg_ID", result_ID);
}

export testcase testWaitForEcho_FD_msg_ID()
{ 
    result_ID = testWaitForMessage(expected_CAN_FD_echo_frame.id, timeout);
    CheckTestResult("testWaitForEcho_FD_msg_ID", result_ID);
}

export testcase testWaitForCAN_FD_msg_Content()
{  
    result_Message = testWaitForSignalMatch(CAN_FD_MSG::CAN_FD_SIGNAL, 0xAAAAAAAA, timeout);
    CheckTestResult("testWaitForCAN_FD_msg_Content", result_Message);
}

export testcase testWaitForEcho_FD_msg_Content()
{ 
    result_Message = testWaitForSignalMatch(CAN_FD_ECHO_MSG::CAN_FD_SIGNAL, 0x00AAAAAA,timeout);
    CheckTestResult("testWaitForEcho_FD_msg_Content", result_Message);
}