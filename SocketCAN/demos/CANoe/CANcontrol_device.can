/*@!Encoding:65001*/
includes
{
  
}

variables
{ 
  message CAN1.200 canMsg = {dlc = 4, byte(0) = 0x87, byte(1) = 0x65, byte(2) = 0x43, byte(3) = 0x21};  
  msTimer timer1;
  dword SendRequested = 0; 
}

void reset()
{
  timer1.cancel();
  sysSetVariableString("UIVariables","SendingStatus", "OFF");
}

on start
{
  timer1.setCyclic(500);
}

on stopMeasurement
{
  reset();
}

on timer timer1
{
  if(SendRequested)
  {
    output(canMsg);
  }
}

on sysvar_update UIVariables::ToggleSending
{ 
  if(@UIVariables::ToggleSending == 0)
  {
      if(!SendRequested)
      {
        SendRequested = 1;
        sysSetVariableString("UIVariables","SendingStatus", "ON");
      }
      else
      {
        SendRequested = 0; 
        sysSetVariableString("UIVariables","SendingStatus", "OFF");
      }
  }
}