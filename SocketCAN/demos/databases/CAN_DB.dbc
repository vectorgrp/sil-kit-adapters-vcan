VERSION ""

NS_ :

BS_:

BU_:

BO_ 6 CAN_FD_ECHO_MSG: 64 Vector__XXX
 SG_ CAN_FD_SIGNAL_3 : 71|32@0+ (1,0) [0|4294967295] "" Vector__XXX
 SG_ CAN_FD_SIGNAL_2 : 39|32@0+ (1,0) [0|4294967295] "" Vector__XXX
 SG_ CAN_FD_SIGNAL_1 : 7|32@0+ (1,0) [0|4294967295] "" Vector__XXX

BO_ 5 CAN_FD_MSG: 64 Vector__XXX
 SG_ CAN_FD_SIGNAL_3 : 71|32@0+ (1,0) [0|4294967295] "" Vector__XXX
 SG_ CAN_FD_SIGNAL_2 : 39|32@0+ (1,0) [0|4294967295] "" Vector__XXX
 SG_ CAN_FD_SIGNAL_1 : 7|32@0+ (1,0) [0|4294967295] "" Vector__XXX

BO_ 2 CAN_ECHO_MSG: 4 Vector__XXX
 SG_ CAN_SIGNAL : 0|32@1+ (1,0) [0|4294967295] "" Vector__XXX

BO_ 1 CAN_MSG: 4 Vector__XXX
 SG_ CAN_SIGNAL : 0|32@1+ (1,0) [0|4294967295] "" Vector__XXX

BA_DEF_ BO_  "VFrameFormat" ENUM  "StandardCAN","ExtendedCAN","reserved","reserved","reserved","reserved","reserved","reserved","reserved","reserved","reserved","reserved","reserved","reserved","StandardCAN_FD","ExtendedCAN_FD";
BA_DEF_  "BusType" STRING ;
BA_DEF_DEF_  "VFrameFormat" "ExtendedCAN_FD";
BA_DEF_DEF_  "BusType" "CAN";
BA_ "BusType" "CAN FD";
BA_ "VFrameFormat" BO_ 6 14;
BA_ "VFrameFormat" BO_ 5 14;
BA_ "VFrameFormat" BO_ 2 0;
BA_ "VFrameFormat" BO_ 1 0;
