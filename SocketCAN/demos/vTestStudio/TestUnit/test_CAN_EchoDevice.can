/*@!Encoding:65001*/
includes
{
  
}

variables
{
  int result_ID;
  int result_Message;
  //char netName[10] = "CAN 1";
  dword timeout = 2000; 
  byte msgData[8]; // standard CAN fram max size 
  
  message 100 ExpectedSocketCANFrame = {byte(0) = 0xAA, byte(1) = 0xAA, byte(2) = 0xBB, byte(3) = 0xBB};
  message 101 ExpectedEchoCANFrame = {byte(0) = 0xAA, byte(1) = 0xBB, byte(2) = 0xBB, byte(3) = 0x00};

  
  dword SocketCAN_ID = 1;
  dword CANEchoDevice_ID = 2;
  
  //message CAN1.* SocketCAN_message;
  //message CAN1.* CANEchoDevice_message;
  
}

/*on message CAN1.*
{
  if(this.dir != rx) return; //make sure msg has been received, otherwise return
  
  if(this.id == SocketCAN_ID)
    SocketCAN_message = this;
  else if (this.id == CANEchoDevice_ID)
    CANEchoDevice_message = this;
  else
    return;
}*/

void CheckTestResult(char testName[], int result)
{
  if (result != 1)
  {
    TestStepFail(testName, "FAILED: No message within timeout");
  }
  TestStepPass(testName, "SUCCESS");
}

export testcase testWaitForCAN_msg_ID()
{  
    result_ID = testWaitForMessage(SocketCAN_ID, timeout);
    result_Message = testWaitForMessage(100, timeout);
    CheckTestResult("testWaitForCAN_msg", result_ID);
}

export testcase testWaitForEcho_msg_ID()
{ 
    result_ID = testWaitForMessage(CANEchoDevice_ID, timeout);
    CheckTestResult("testWaitForEcho_msg", result_ID);
}

export testcase testWaitForCAN_msg_Content()
{  
    result_Message = testWaitForMessage(100, timeout);
    CheckTestResult("testWaitForCAN_msg", result_ID);
}

export testcase testWaitForEcho_msg_Content()
{ 
    result_Message = testWaitForMessage(101, timeout);
    CheckTestResult("testWaitForEcho_msg", result_ID);
}
